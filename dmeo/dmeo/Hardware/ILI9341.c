#include "stm32l0xx_hal.h"
#include "ili9341.h"

const unsigned char asc2_1608[95][16]={
{0x00,0x00,0x00,0x00,0x00,0x00,0x00,0x00,0x00,0x00,0x00,0x00,0x00,0x00,0x00,0x00},/*" ",0*/
{0x00,0x00,0x00,0x08,0x08,0x08,0x08,0x08,0x08,0x08,0x00,0x00,0x18,0x18,0x00,0x00},/*"!",1*/
{0x00,0x48,0x6C,0x24,0x12,0x00,0x00,0x00,0x00,0x00,0x00,0x00,0x00,0x00,0x00,0x00},/*""",2*/
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{0x0C,0x32,0xC2,0x00,0x00,0x00,0x00,0x00,0x00,0x00,0x00,0x00,0x00,0x00,0x00,0x00},/*"~",94*/
};  

//gImage_lsd
//-------------------//

const unsigned char gImage_lsd[2970] = { /* 0X00,0X01,0XF0,0X00,0X63,0X00, */
0X00,0X00,0X00,0X00,0X00,0X00,0X00,0X00,0X00,0X00,0X00,0X00,0X00,0X00,0X00,0X00,
0X00,0X00,0X00,0X00,0X00,0X00,0X00,0X00,0X00,0X00,0X00,0X00,0X00,0XF8,0X00,0X00,
0X00,0X00,0X07,0XE0,0X00,0X00,0X00,0X00,0X00,0X00,0X00,0X00,0X00,0X00,0X00,0X00,
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0XE0,0XF8,0X1E,0X07,0XC1,0XFF,0XFF,0XFC,0X00,0X00,};




extern SPI_HandleTypeDef hspi1;

void delay_10ms(int count)   /* 10ms */
{
	uint32_t now =0 , GoTo = 0;
	now = HAL_GetTick();

	GoTo = now + 10*count;

	while(GoTo != HAL_GetTick());           
}


void  ILI9341_INITIAL(void)
 { 
	//------------------------------------ST7735R Reset Sequence-----------------------------------------// 
	RES_HIGH(); 
	delay_10ms(20);         //Delay 10ms 
	RES_LOW(); 
	delay_10ms(40);          //Delay 200ms 
	RES_HIGH(); 
	delay_10ms(20);                                                              //Delay 120ms 

	//************* Start Initial Sequence **********// 
	LCD_WriteCommand(0xCF);  //功耗B
	LCD_WriteData(0x00); 
	LCD_WriteData(0xD9); 
	LCD_WriteData(0X30); 
	 
	LCD_WriteCommand(0xED);  //电源序列
	LCD_WriteData(0x64); 
	LCD_WriteData(0x03); 
	LCD_WriteData(0X12); 
	LCD_WriteData(0X81); 
	 
	LCD_WriteCommand(0xE8);  //驱动时序A
	LCD_WriteData(0x85); 
	LCD_WriteData(0x10); 
	LCD_WriteData(0x78); 
	 
	LCD_WriteCommand(0xCB);  //功耗A
	LCD_WriteData(0x39); 
	LCD_WriteData(0x2C); 
	LCD_WriteData(0x00); 
	LCD_WriteData(0x34); 
	LCD_WriteData(0x02); 
	 
	LCD_WriteCommand(0xF7);  //泵比
	LCD_WriteData(0x20); 
	 
	LCD_WriteCommand(0xEA);  //驱动时序B
	LCD_WriteData(0x00); 
	LCD_WriteData(0x00); 
	 
	LCD_WriteCommand(0xC0);    //Power control 
	LCD_WriteData(0x21);   //VRH[5:0] 
	 
	LCD_WriteCommand(0xC1);    //Power control 
	LCD_WriteData(0x12);   //SAP[2:0];BT[3:0] 
	 
	LCD_WriteCommand(0xC5);    //VCM control 
	LCD_WriteData(0x32); 
	LCD_WriteData(0x3C); 
	 
	LCD_WriteCommand(0xC7);    //VCM control2 
	LCD_WriteData(0XC1); 
	 
	LCD_WriteCommand(0x36);    // Memory Access Control 
	LCD_WriteData(0x08); 
	 
	LCD_WriteCommand(0x3A);   
	LCD_WriteData(0x55); 

	LCD_WriteCommand(0xB1);   
	LCD_WriteData(0x00);   
	LCD_WriteData(0x18); 
	 
	LCD_WriteCommand(0xB6);    // Display Function Control 
	LCD_WriteData(0x0A); 
	LCD_WriteData(0xA2); 

	 
	 
	LCD_WriteCommand(0xF2);    // 3Gamma Function Disable 
	LCD_WriteData(0x00); 
	 
	LCD_WriteCommand(0x26);    //Gamma curve selected 
	LCD_WriteData(0x01); 
	 
	LCD_WriteCommand(0xE0);    //Set Gamma 
	LCD_WriteData(0x0F); 
	LCD_WriteData(0x20); 
	LCD_WriteData(0x1E); 
	LCD_WriteData(0x09); 
	LCD_WriteData(0x12); 
	LCD_WriteData(0x0B); 
	LCD_WriteData(0x50); 
	LCD_WriteData(0XBA); 
	LCD_WriteData(0x44); 
	LCD_WriteData(0x09); 
	LCD_WriteData(0x14); 
	LCD_WriteData(0x05); 
	LCD_WriteData(0x23); 
	LCD_WriteData(0x21); 
	LCD_WriteData(0x00); 
	 
	LCD_WriteCommand(0XE1);    //Set Gamma 
	LCD_WriteData(0x00); 
	LCD_WriteData(0x19); 
	LCD_WriteData(0x19); 
	LCD_WriteData(0x00); 
	LCD_WriteData(0x12); 
	LCD_WriteData(0x07); 
	LCD_WriteData(0x2D); 
	LCD_WriteData(0x28); 
	LCD_WriteData(0x3F); 
	LCD_WriteData(0x02); 
	LCD_WriteData(0x0A); 
	LCD_WriteData(0x08); 
	LCD_WriteData(0x25); 
	LCD_WriteData(0x2D); 
	LCD_WriteData(0x0F); 
	 
	LCD_WriteCommand(0x11);    //Exit Sleep 
	delay_10ms(12); 
	LCD_WriteCommand(0x29);    //Display on 
 
} 

//========================================================
void  LCD_WriteCommand(uint8_t c)
{
	uint8_t data[1] ;
	SPI_HandleTypeDef *spi1 = &hspi1;

	data[0] = c;
	
     DC_LOW();
     CS_LOW();
	 
     HAL_SPI_Transmit(spi1,data,1,2000);
	 
     CS_HIGH();	
}

//========================================================

void LCD_WriteData(uint8_t dat)
{
	uint8_t data[1] ;
	SPI_HandleTypeDef *spi1 = &hspi1;

	data[0] = dat;
	
      DC_HIGH();
      CS_LOW();
	  
      HAL_SPI_Transmit(spi1,data,1,2000);
	 
      CS_HIGH();
}

//========================================================
void LCD_Write_Data(uint16_t dat16)
{
  LCD_WriteData(dat16>>8);
  LCD_WriteData(dat16);
}

void LCD_Write_Data1(uint8_t dat1,uint8_t dat2)
{
 	uint8_t data[2] ;
	SPI_HandleTypeDef *spi1 = &hspi1;

	data[0] = dat1;
	data[1] = dat2;
 
      DC_HIGH();
      CS_LOW();
	  
      HAL_SPI_Transmit(spi1,data,1,2000);
	  
	  CS_HIGH();

	  CS_LOW();
	  
	  HAL_SPI_Transmit(spi1,data+1,1,2000);
	  
	  CS_HIGH();
     
  
}

/****************************************************************************
* 名    称：void ili9341_DrawPicture(u16 StartX,u16 StartY,u16 EndX,u16 EndY,const unsigned char *pic)
* 功    能：在指定座标范围显示一副图片
* 入口参数：StartX     行起始座标
*           StartY     列起始座标
*           EndX      行结束座标
*           EndY       列结束座标
            pic             图片头指针
* 出口参数：无
* 说    明：图片取模格式为水平扫描，16位颜色模式
* 调用方法：ili9320_DrawPicture(0,0,100,100,(u16*)demo);
****************************************************************************/
void LCD_ili9341_DrawPicture(uint16_t StartX,uint16_t StartY,uint16_t Xend,uint16_t Yend,const unsigned char *pic,uint8_t mode)
{
    uint32_t i=0,j=0;
	uint8_t temp = 0;
	uint32_t piont = 0,zheng = 0,yu= 0;


	uint16_t *bitmap = (uint16_t *)pic;
	uint8_t *bitmap1 = (uint8_t *)pic;

	if(mode == 1)
	{
    
	    LCDOpenWindows(StartX,StartY,Xend-StartX,Yend-StartY);
	    
	    for(i=StartY;i<Yend;i++)
	    {
	        for(j=StartX;j<Xend;j++)
			{
				LCD_Write_Data(*bitmap++); 
			}        
	    }
	}else if(mode ==4)
		{
			LCDOpenWindows(StartX,StartY,Xend-StartX,Yend-StartY);
			piont = (Xend-StartX) * (Yend-StartY);
			zheng = piont/8;
			yu = piont%8;

			for(i= 0 ; i<zheng; i++)
			{
				temp = *bitmap1;
				for(uint8_t u=0;u<8;u++)
				{
					if((temp & 0x80) == 0x00)
					{
						LCD_Write_Data(0xd6db);
					}else
						{
							LCD_Write_Data(0x0a93);
						}
					temp = temp<<1;
				}
				bitmap1++;   
			}

			for(j=0;j<yu;j++)
			{
				temp = *bitmap1;
				for(uint8_t u=0;u<8;u++)
				{
					if((temp & 0x80) == 0x00)
					{
						LCD_Write_Data(0xd6db);
					}else
						{
							LCD_Write_Data(0x0a93);
						}
					temp = temp<<1;
				} 
			}
		  
		}
    
}

void LCDOpenWindows(uint16_t x, uint16_t y, uint16_t len, uint16_t wid)
{
	 LCD_WriteCommand(0x2A);
     LCD_WriteData(x>>8);
     LCD_WriteData(x-((x>>8)<<8));
     LCD_WriteData((x+len-1)>>8);
     LCD_WriteData((x+len-1)-(((x+len-1)>>8)<<8));

     LCD_WriteCommand(0x2B);
     LCD_WriteData(y>>8);
     LCD_WriteData(y-((y>>8)<<8));
     LCD_WriteData((y+wid-1)>>8);
     LCD_WriteData((y+wid-1)-(((y+wid-1)>>8)<<8));
     LCD_WriteCommand(0x2C);
}


void test_tt(void)
{
	lLED_ON();

	//LCD_Clear(0xbefe);

	LCD_Fill(0,0,240,105,0xd6db);
    LCD_ili9341_DrawPicture(0,105,240,204,gImage_lsd,4);
    LCD_Fill(0,204,240,320,0xd6db);
//	LCD_ShowString(78,2,"LSD-LoRaWAN",0xd6db);
//	LCD_Fill(170,0,240,20,0xed68);

	//LCD_Fill(0,20,240,290,0x0348);
	//LCD_Fill(0,0,240,290,BLACK);
	//LCD_ShowString(120,120,"FUCK",YELLOW);
	//LCD_ShowNum(120,120,4999,4,YELLOW);

	//LCD_Fill(140,200,200,260,WHITE);

	//LCD_DrawLine(50,220,120,260,RED);

	//LCD_DrawRectangle(20,100,60,140,YELLOW);

	//Draw_Circle(150,80,30,BLUE);
}


////////////////////////////手动描点、数字、字符 ////////////////////

void LCD_DrawPoint(uint16_t x,uint16_t y,uint8_t size,uint16_t color)
{
	static uint16_t i=0,j=0;
	
	LCDOpenWindows(x,y,size,size);

	for(i=0;i<size;i++)
    {
        for(j=0;j<size;j++)
		{
			LCD_Write_Data(color); 
		}        
    }
} 

//画线
//x1,y1:起点坐标
//x2,y2:终点坐标  
void LCD_DrawLine(u16 x1, u16 y1, u16 x2, u16 y2, u16 color)
{
	u16 t; 
	int xerr=0,yerr=0,delta_x,delta_y,distance; 
	int incx,incy,uRow,uCol; 

	delta_x=x2-x1; //计算坐标增量 
	delta_y=y2-y1; 
	uRow=x1; 
	uCol=y1; 
	if(delta_x>0)incx=1; //设置单步方向 
	else if(delta_x==0)incx=0;//垂直线 
	else {incx=-1;delta_x=-delta_x;} 
	if(delta_y>0)incy=1; 
	else if(delta_y==0)incy=0;//水平线 
	else{incy=-1;delta_y=-delta_y;} 
	if( delta_x>delta_y)distance=delta_x; //选取基本增量坐标轴 
	else distance=delta_y; 
	for(t=0;t<=distance+1;t++ )//画线输出 
	{  
		LCD_DrawPoint(uRow,uCol,1,color);//画点 
		xerr+=delta_x ; 
		yerr+=delta_y ; 
		if(xerr>distance) 
		{ 
			xerr-=distance; 
			uRow+=incx; 
		} 
		if(yerr>distance) 
		{ 
			yerr-=distance; 
			uCol+=incy; 
		} 
	}  
} 

//画矩形
void LCD_DrawRectangle(u16 x1, u16 y1, u16 x2, u16 y2 ,u16 color)
{
	LCD_DrawLine(x1,y1,x2,y1,color);
	LCD_DrawLine(x1,y1,x1,y2,color);
	LCD_DrawLine(x1,y2,x2,y2,color);
	LCD_DrawLine(x2,y1,x2,y2,color);
}

//在指定位置画一个指定大小的圆
//(x,y):中心点
//r    :半径
void Draw_Circle(u16 x0,u16 y0,u8 r, u16 color)
{
	int a,b;
	int di;
	a=0;b=r;	  
	di=3-(r<<1);             //判断下个点位置的标志
	while(a<=b)
	{
		LCD_DrawPoint(x0-b,y0-a,1,color);             //3           
		LCD_DrawPoint(x0+b,y0-a,1,color);             //0           
		LCD_DrawPoint(x0-a,y0+b,1,color);             //1       
		LCD_DrawPoint(x0-b,y0-a,1,color);             //7           
		LCD_DrawPoint(x0-a,y0-b,1,color);             //2             
		LCD_DrawPoint(x0+b,y0+a,1,color);             //4               
		LCD_DrawPoint(x0+a,y0-b,1,color);             //5
		LCD_DrawPoint(x0+a,y0+b,1,color);             //6 
		LCD_DrawPoint(x0-b,y0+a,1,color);             
		a++;
		//使用Bresenham算法画圆     
		if(di<0)di +=4*a+6;	  
		else
		{
			di+=10+4*(a-b);   
			b--;
		} 
		LCD_DrawPoint(x0+a,y0+b,1,color);
	}
} 


void LCD_ShowChar(uint16_t x,uint16_t y,uint8_t num,uint16_t color)
{    	  
	uint8_t pos,temp,t;
	
	num=num-' ';//得到偏移后的值
	
	for(pos=0;pos<16;pos++)
	{
		temp=asc2_1608[num][pos];//调用1206字体

		for(t=0;t<8;t++)
	    {                 
	        if(temp&0x01)LCD_DrawPoint(x+t,y+pos,1,color);//画一个点     
	        temp>>=1; 
	    }
	}
	    	   	 	  
}  


u32 mypow(u8 m,u8 n)
{
	u32 result=1;	 
	while(n--)result*=m;    
	return result;
}			 
//显示2个数字
//x,y :起点坐标	 
//len :数字的位数
//size:字体大小
//color:颜色
//num:数值(0~4294967295);	 
void LCD_ShowNum(u16 x,u16 y,u32 num,u8 len,u16 color)
{         	
	u8 t,temp;
	u8 enshow=0;						   
	for(t=0;t<len;t++)
	{
		temp=(num/mypow(10,len-t-1))%10;
		if(enshow==0&&t<(len-1))
		{
			if(temp==0)
			{
				LCD_ShowChar(x+(8)*t,y,' ',color);
				continue;
			}else enshow=1; 
		 	 
		}
	 	LCD_ShowChar(x+(8)*t,y,temp+'0',color); 
	}
} 


void LCD_Clear(uint16_t color)
{
	static uint16_t i=0,j=0;
	
	LCDOpenWindows(0,0,240,320);
	
	for(i=0;i<240;i++)
    {
        for(j=0;j<320;j++)
		{
			LCD_Write_Data(color); 
		}        
    }
}


//在指定区域内填充指定颜色
//区域大小:
//  (xend-xsta)*(yend-ysta)

void LCD_Fill(uint16_t xsta,uint16_t ysta,uint16_t xend,uint16_t yend,uint16_t color)
{          
	static uint16_t i=0,j=0;
	
	LCDOpenWindows(xsta,ysta,xend-xsta,yend-ysta);
	
	for(i=xsta;i<xend;i++)
    {
        for(j=ysta;j<yend;j++)
		{
			LCD_Write_Data(color); 
		}        
    }			  	    
}



//显示字符串
//x,y:起点坐标  
//*p:字符串起始地址
//用16字体
void LCD_ShowString(uint16_t x,uint16_t y,const uint8_t *p,uint16_t color)
{         
    while(*p!='\0')
    {       
        if(x>240){x=0;y+=16;}
        if(y>320){y=x=0;LCD_Clear(WHITE);}
        LCD_ShowChar(x,y,*p,color);
        x+=8;
        p++;
    }  
}

